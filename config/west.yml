## config/west.yml
```yaml
manifest:
  defaults:
    revision: v0.3.0
  remotes:
    - name: zmkfirmware
      url-base: https://github.com/zmkfirmware
    - name: nguyendown
      url-base: https://github.com/nguyendown
    # Additional modules containing boards/shields/custom code can be listed here as well
    # See https://docs.zephyrproject.org/3.2.0/develop/west/manifest.html#projects
  projects:
    - name: zmk
      remote: zmkfirmware
      import: app/west.yml
    - name: zmk-cresk-module
      remote: nguyendown
      revision: 8402aa2f2c08ef329da21256e32c490ff883fea1
  self:
    path: config
```
